// Overrides for the input-split child node
&trackball_peripheral_split {
  device = <&trackball_central>;
  input-processors
    = <&zip_xy_to_scroll_mapper>
    , <&zip_scroll_scaler 1 5>
    , <&zip_ble_report_rate_limit>;
};
